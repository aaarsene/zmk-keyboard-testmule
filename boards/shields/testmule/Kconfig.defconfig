## boards/shields/testmule/Kconfig.defconfig
```kconfig
if SHIELD_TESTMULE

# Name must be less than 16 characters long!
config ZMK_KEYBOARD_NAME
    default "Test Mule"

endif
```

## boards/shields/testmule/Kconfig.shield
```kconfig
# No whitespace after the comma or in your keyboard name!
config SHIELD_TESTMULE
    def_bool $(shields_list_contains,testmule)
```
